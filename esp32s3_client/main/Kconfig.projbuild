## esp32s3_client/main/Kconfig.projbuild
```kconfig
menu "Remote Face Client"

config REMOTE_FACE_WIFI_SSID
    string "WiFi SSID"
    default ""

config REMOTE_FACE_WIFI_PASSWORD
    string "WiFi password"
    default ""

config REMOTE_FACE_DETECT_URL
    string "PC detect URL"
    default "http://192.168.1.23:8080/detect"

config REMOTE_FACE_HTTP_TIMEOUT_MS
    int "HTTP timeout ms"
    default 10000

config REMOTE_FACE_DETECT_INTERVAL_MS
    int "Detect interval ms"
    default 800

endmenu
```

## esp32s3_client/sdkconfig.defaults
```kconfig
CONFIG_ESP32S3_SPIRAM_SUPPORT=y
CONFIG_SPIRAM=y
CONFIG_SPIRAM_MODE_OCT=y
CONFIG_SPIRAM_SPEED_80M=y
CONFIG_SPIRAM_MALLOC_ALWAYSINTERNAL=16384
CONFIG_SPIRAM_USE_MALLOC=y
CONFIG_FREERTOS_HZ=1000
CONFIG_LV_COLOR_DEPTH_16=y
CONFIG_LV_COLOR_DEPTH=16
CONFIG_LV_COLOR_16_SWAP=y
```
